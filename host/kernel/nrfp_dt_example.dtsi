&spi1 {
	status = "okay";
	nrfp@0 {
		compatible = "viriz,nrf5340-proxy";
		reg = <0>;
		spi-max-frequency = <8000000>;
		host-irq-gpios = <&gpio0 12 GPIO_ACTIVE_HIGH>;
		reset-gpios = <&gpio0 13 GPIO_ACTIVE_LOW>;
		boot-gpios = <&gpio0 14 GPIO_ACTIVE_HIGH>;
	};
};

