## CMakeLists.txt
```
cmake_minimum_required(VERSION 3.20.0)
find_package(Zephyr REQUIRED HINTS $ENV{ZEPHYR_BASE})
project(nrfp_proxy)

target_include_directories(app PRIVATE
	${CMAKE_CURRENT_SOURCE_DIR}/../common/include
	${CMAKE_CURRENT_SOURCE_DIR}/src
)

target_sources(app PRIVATE
	src/main.c
	src/tl_crc.c
	src/tl_frame.c
	src/tl_batch.c
	src/tl_codec.c
	src/tl_transport.c
	src/spis_link.c
	src/svc_nfc.c
)
```

## west.yml
```
manifest:
  version: 0.13
  self:
    path: firmware
  remotes:
    - name: ncs
      url-base: https://github.com/nrfconnect
  projects:
    - name: sdk-nrf
      remote: ncs
      revision: v2.7.0
      import: true
```

## prj.conf
```kconfig
CONFIG_MAIN_STACK_SIZE=4096
CONFIG_HEAP_MEM_POOL_SIZE=8192
CONFIG_SPI=y
CONFIG_SPI_SLAVE=y
CONFIG_GPIO=y
CONFIG_LOG=y
CONFIG_LOG_DEFAULT_LEVEL=3
CONFIG_ASSERT=y
CONFIG_BT=y
CONFIG_BT_PERIPHERAL=y
CONFIG_BT_MAX_CONN=20
```

## src/main.c
```c
#include <stdint.h>

#ifdef __ZEPHYR__
#include <zephyr/kernel.h>
#include <zephyr/logging/log.h>

LOG_MODULE_REGISTER(nrfp_main, LOG_LEVEL_INF);
#endif

int nrfp_spis_init(void);
void nrfp_tl_transport_reset(void);

int main(void)
{
	nrfp_tl_transport_reset();
	nrfp_spis_init();

#ifdef __ZEPHYR__
	LOG_INF("nRFP firmware scaffold started");
	while (1) {
		k_sleep(K_MSEC(1000));
	}
#endif
	return 0;
}
```

## src/spis_link.c
```c
#include <stdint.h>

#ifdef __ZEPHYR__
#include <zephyr/device.h>
#include <zephyr/drivers/spi.h>
#include <zephyr/logging/log.h>

LOG_MODULE_REGISTER(nrfp_spis, LOG_LEVEL_INF);

static const struct device *spis_dev;

int nrfp_spis_init(void)
{
	spis_dev = DEVICE_DT_GET_ANY(nordic_nrf_spis);
	if (!spis_dev || !device_is_ready(spis_dev)) {
		LOG_ERR("SPIS not ready");
		return -1;
	}

	LOG_INF("SPIS initialized");
	return 0;
}
#else
int nrfp_spis_init(void)
{
	return 0;
}
#endif
```

## src/svc_nfc.c
```c
#include <stddef.h>
#include <stdint.h>

#include "../../common/include/nrfp_proto.h"
#include "tl_codec.h"

int nrfp_svc_nfc_handle(const struct nrfp_tl_frame *req, struct nrfp_tl_frame *rsp)
{
	if (!req || !rsp) {
		return -1;
	}

	rsp->hdr = req->hdr;
	rsp->hdr.flags |= NRFP_FLAG_IS_ACK;
	rsp->hdr.ack_seq = req->hdr.seq;
	rsp->hdr.status = NRFP_STATUS_UNSUPPORTED;
	rsp->hdr.payload_len_le = nrfp_u16_to_le(0);
	rsp->payload = NULL;

	switch (req->hdr.opcode) {
	case NRFP_OP_NFC_INIT:
	case NRFP_OP_NFC_MODE:
	case NRFP_OP_NFC_APDU_TX:
	case NRFP_OP_NFC_RAW_FRAME:
		rsp->hdr.status = NRFP_STATUS_OK;
		break;
	default:
		break;
	}

	return 0;
}
```

## src/tl_batch.c
```c
#include "tl_frame.h"

int nrfp_frame_aggregate(const struct nrfp_tl_frame *frames, size_t frame_count, uint8_t *out,
 size_t out_len, size_t *written, size_t *packed_count)
{
size_t i;
size_t used = 0;
size_t packed = 0;

if ((!frames && frame_count) || !out || !written || !packed_count)
return -1;
for (i = 0; i < frame_count; i++) {
size_t one;
uint8_t flags = frames[i].hdr.flags;
size_t payload_len = nrfp_u16_from_le(frames[i].hdr.payload_len_le);
int rc;

		/* Keep idle-frame filtering consistent with host aggregator to save SPI bandwidth. */
		if (payload_len == 0u &&
		    (flags & (NRFP_FW_FLAG_REQ_ACK | NRFP_FW_FLAG_IS_ACK | NRFP_FW_FLAG_IS_NAK)) == 0u)
			continue;
rc = nrfp_frame_encode(out + used, out_len - used, &frames[i], &one);
if (rc)
return rc;
used += one;
packed++;
}
*written = used;
*packed_count = packed;
return 0;
}
```

## src/tl_codec.c
```c
#include "tl_codec.h"

int nrfp_tl_encode(uint8_t *out, size_t out_len, const struct nrfp_tl_frame *frame, size_t *written)
{
	return nrfp_frame_encode(out, out_len, frame, written);
}

int nrfp_tl_decode(const uint8_t *in, size_t in_len, struct nrfp_tl_frame *frame, uint16_t *consumed_len)
{
	return nrfp_frame_decode(in, in_len, frame, consumed_len);
}
```

## src/tl_codec.h
```c
#ifndef NRFP_FW_TL_CODEC_H
#define NRFP_FW_TL_CODEC_H

#include <stddef.h>
#include <stdint.h>

#include "tl_frame.h"

int nrfp_tl_encode(uint8_t *out, size_t out_len, const struct nrfp_tl_frame *frame, size_t *written);
int nrfp_tl_decode(const uint8_t *in, size_t in_len, struct nrfp_tl_frame *frame, uint16_t *consumed_len);

#endif /* NRFP_FW_TL_CODEC_H */
```

## src/tl_crc.c
```c
#include "tl_frame.h"

uint16_t nrfp_crc16(const uint8_t *buf, size_t len)
{
return nrfp_crc16_ccitt_false(buf, len);
}
```

## src/tl_frame.c
```c
#include "tl_frame.h"

#include <string.h>

static size_t nrfp_fw_payload_len(const struct nrfp_tl_frame *frame)
{
return nrfp_u16_from_le(frame->hdr.payload_len_le);
}

int nrfp_frame_encode(uint8_t *out, size_t out_len, const struct nrfp_tl_frame *frame, size_t *written)
{
size_t payload_len;
size_t total_wo_crc;
uint16_t crc;

if (!out || !frame || !written)
return -1;
if (frame->hdr.sof != NRFP_TL_SOF || frame->hdr.version != NRFP_TL_VERSION)
return -2;
if (nrfp_channel_from_flags(frame->hdr.flags) >= NRFP_CHANNEL_COUNT)
return -3;
payload_len = nrfp_fw_payload_len(frame);
if (payload_len > NRFP_TL_MAX_PAYLOAD)
return -4;
total_wo_crc = sizeof(struct nrfp_tl_header) + payload_len;
if (out_len < total_wo_crc + sizeof(uint16_t))
return -5;
if (payload_len && !frame->payload)
return -6;

memcpy(out, &frame->hdr, sizeof(frame->hdr));
if (payload_len)
memcpy(out + sizeof(frame->hdr), frame->payload, payload_len);
crc = nrfp_crc16(out, total_wo_crc);
out[total_wo_crc] = (uint8_t)(crc & 0xFFu);
out[total_wo_crc + 1u] = (uint8_t)(crc >> 8);
*written = total_wo_crc + sizeof(uint16_t);
return 0;
}

int nrfp_frame_decode(const uint8_t *in, size_t in_len, struct nrfp_tl_frame *frame, uint16_t *consumed_len)
{
uint16_t payload_len;
size_t total_wo_crc;
size_t total;
uint16_t expected_crc;
uint16_t got_crc;

if (!in || !frame || !consumed_len || in_len < sizeof(struct nrfp_tl_header) + sizeof(uint16_t))
return -1;

memcpy(&frame->hdr, in, sizeof(frame->hdr));
if (frame->hdr.sof != NRFP_TL_SOF || frame->hdr.version != NRFP_TL_VERSION)
return -2;
if (nrfp_channel_from_flags(frame->hdr.flags) >= NRFP_CHANNEL_COUNT)
return -3;
payload_len = nrfp_u16_from_le(frame->hdr.payload_len_le);
if (payload_len > NRFP_TL_MAX_PAYLOAD)
return -4;
total_wo_crc = sizeof(struct nrfp_tl_header) + payload_len;
total = total_wo_crc + sizeof(uint16_t);
if (in_len < total)
return -5;
got_crc = (uint16_t)in[total_wo_crc] | ((uint16_t)in[total_wo_crc + 1u] << 8);
expected_crc = nrfp_crc16(in, total_wo_crc);
if (got_crc != expected_crc)
return -6;
frame->payload = payload_len ? (in + sizeof(struct nrfp_tl_header)) : NULL;
*consumed_len = (uint16_t)total;
return 0;
}

int nrfp_frame_fragment(const struct nrfp_tl_frame *src, uint16_t max_payload,
struct nrfp_fw_fragment_cursor *cursor, uint8_t *fragment_payload,
size_t fragment_payload_len, struct nrfp_tl_frame *out, bool *finished)
{
size_t payload_len;
size_t mtu_data;
size_t left;
size_t chunk;

if (!src || !cursor || !fragment_payload || !out || !finished)
return -1;
payload_len = nrfp_fw_payload_len(src);
if (payload_len <= max_payload) {
*out = *src;
*finished = true;
return 0;
}
if (max_payload <= NRFP_FW_FRAGMENT_META_SIZE)
return -2;
if (!src->payload)
return -3;
mtu_data = max_payload - NRFP_FW_FRAGMENT_META_SIZE;
if (!cursor->total)
cursor->total = (uint8_t)((payload_len + mtu_data - 1u) / mtu_data);
if (cursor->offset >= payload_len)
return -4;
left = payload_len - cursor->offset;
chunk = left > mtu_data ? mtu_data : left;
if (fragment_payload_len < chunk + NRFP_FW_FRAGMENT_META_SIZE)
return -5;
fragment_payload[0] = cursor->index;
fragment_payload[1] = cursor->total;
fragment_payload[2] = (uint8_t)(payload_len & 0xFFu);
fragment_payload[3] = (uint8_t)(payload_len >> 8);
memcpy(fragment_payload + NRFP_FW_FRAGMENT_META_SIZE, src->payload + cursor->offset, chunk);
*out = *src;
out->payload = fragment_payload;
out->hdr.payload_len_le = nrfp_u16_to_le((uint16_t)(chunk + NRFP_FW_FRAGMENT_META_SIZE));
cursor->offset = (uint16_t)(cursor->offset + chunk);
cursor->index++;
*finished = (cursor->offset >= payload_len);
return 0;
}
```

## src/tl_frame.h
```c
#ifndef NRFP_FW_TL_FRAME_H
#define NRFP_FW_TL_FRAME_H

#include <stdbool.h>
#include <stddef.h>
#include <stdint.h>

#include "../../common/include/nrfp_proto.h"

#define NRFP_FW_FLAG_REQ_ACK NRFP_FLAG_ACK_REQ
#define NRFP_FW_FLAG_IS_ACK NRFP_FLAG_IS_ACK
#define NRFP_FW_FLAG_IS_NAK 0x80u
#define NRFP_FW_RETRY_TIMEOUT_MS 50u
#define NRFP_FW_RETRY_MAX_ATTEMPTS 3u
#define NRFP_FW_FRAGMENT_META_SIZE 4u

struct nrfp_tl_frame {
struct nrfp_tl_header hdr;
const uint8_t *payload;
};

struct nrfp_fw_fragment_cursor {
uint16_t offset;
uint8_t index;
uint8_t total;
};

uint16_t nrfp_crc16(const uint8_t *buf, size_t len);
int nrfp_frame_encode(uint8_t *out, size_t out_len, const struct nrfp_tl_frame *frame, size_t *written);
int nrfp_frame_decode(const uint8_t *in, size_t in_len, struct nrfp_tl_frame *frame, uint16_t *consumed_len);
int nrfp_frame_fragment(const struct nrfp_tl_frame *src, uint16_t max_payload,
		struct nrfp_fw_fragment_cursor *cursor, uint8_t *fragment_payload,
		size_t fragment_payload_len, struct nrfp_tl_frame *out, bool *finished);
int nrfp_frame_aggregate(const struct nrfp_tl_frame *frames, size_t frame_count, uint8_t *out,
			 size_t out_len, size_t *written, size_t *packed_count);

#endif /* NRFP_FW_TL_FRAME_H */
```

## src/tl_transport.c
```c
#include "tl_codec.h"

#include <string.h>

struct nrfp_channel_state {
	uint8_t expected_rx_seq;
	uint8_t next_tx_seq;
	uint8_t last_ack_seq;
};

static struct nrfp_channel_state channel_state[NRFP_CHANNEL_COUNT];

void nrfp_tl_transport_reset(void)
{
	memset(channel_state, 0, sizeof(channel_state));
}

int nrfp_tl_transport_next_seq(uint8_t channel)
{
	if (channel >= NRFP_CHANNEL_COUNT) {
		return -1;
	}
	return channel_state[channel].next_tx_seq++;
}

int nrfp_tl_transport_accept_seq(uint8_t channel, uint8_t seq, uint8_t retry)
{
	struct nrfp_channel_state *s;

	if (channel >= NRFP_CHANNEL_COUNT) {
		return -1;
	}

	s = &channel_state[channel];
	if (seq == s->expected_rx_seq) {
		s->last_ack_seq = seq;
		s->expected_rx_seq++;
		return 0;
	}

	if (retry && seq == (uint8_t)(s->expected_rx_seq - 1u)) {
		return 1;
	}

	return -2;
}
```
